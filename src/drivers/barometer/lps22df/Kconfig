## src/drivers/barometer/lps22df/Kconfig
```kconfig
menuconfig DRIVERS_BAROMETER_LPS22DF
	bool "lps22df"
	default n
	---help---
		Enable support for the ST LPS22DF barometer (SPI)
```

## src/systemcmds/i2cread/Kconfig
```kconfig
menuconfig SYSTEMCMDS_I2CREAD
	bool "i2cread"
	default n
	---help---
		Enable support for i2cread (read bytes from an I2C device register)
```
